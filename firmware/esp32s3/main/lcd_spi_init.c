// HD317001C40 (JD9168S) SPI 初始化
// 序列 1:1 来自 firmware/typixdeck_esp32s3_fw/main/lcd_init.c
// 本板引脚：CS=GPIO5 / SCLK=GPIO47 / MOSI=GPIO48（走 R183/R184/R186）
// 复位脚不在 ESP 上，由 AW9523 P1_1 控制（见 main.c）

#include "lcd_spi_init.h"

#include "freertos/FreeRTOS.h"
#include "freertos/task.h"
#include "driver/spi_master.h"
#include "esp_log.h"
#include "board_pins.h"

static const char *TAG = "LCD_SPI";

// clang-format off
static const uint8_t init_block_00[] = { 0xF1, 0x01, 0x03, 0xDF, 0x91, 0x68, 0xF9 };                     // Password / unlock
static const uint8_t init_block_01[] = { 0xF1, 0x01, 0x01, 0xDE, 0x00 };                                  // Page DE=0
static const uint8_t init_block_02[] = { 0xF1, 0x01, 0x02, 0xB2, 0x00, 0x7E };
static const uint8_t init_block_03[] = { 0xF1, 0x01, 0x02, 0xB3, 0x00, 0x7E };
static const uint8_t init_block_04[] = { 0xF1, 0x01, 0x06, 0xC1, 0x00, 0x0E, 0x00, 0x00, 0x00, 0x00 };
static const uint8_t init_block_05[] = { 0xF1, 0x01, 0x07, 0xBB, 0x02, 0x24, 0x07, 0x61, 0x19, 0x44, 0x44 }; // Power
static const uint8_t init_block_06[] = { 0xF1, 0x01, 0x02, 0xBE, 0x1A, 0xF2 };
static const uint8_t init_block_07[] = {
    0xF1, 0x01, 0x0E, 0xC3, 0x10, 0x17, 0x5A, 0x17, 0x5A,
    0x05, 0x05, 0x05, 0x05, 0x15, 0x15, 0x31, 0x05, 0xDF
};
static const uint8_t init_block_08[] = {
    0xF1, 0x01, 0x07, 0xC4, 0x11, 0x80, 0x00, 0xDF, 0x09, 0x06, 0x14
};
static const uint8_t init_block_09[] = {
    0xF1, 0x01, 0x17, 0xCE,
    0x00, 0x03, 0x03, 0x03, 0x03, 0x03, 0x03, 0x03, 0x03, 0x03,
    0x03, 0x03, 0x03, 0x03, 0x03, 0x03, 0x03, 0x03, 0x03, 0x03, 0x03, 0x0F, 0x03
};
static const uint8_t init_block_10[] = {
    0xF1, 0x01, 0x09, 0xCF,
    0x00, 0x01, 0x40, 0x01, 0xCA, 0x01, 0xCA, 0x01, 0xCA
};
static const uint8_t init_block_11[] = {
    0xF1, 0x01, 0x17, 0xD0,
    0x00, 0x1F, 0x1F, 0x1F, 0x1F, 0x1F, 0x1F, 0x1F, 0x1F, 0x1F,
    0x1F, 0x03, 0x01, 0x05, 0x07, 0x09, 0x0B, 0x1E, 0x15, 0x1F, 0x1F, 0x15, 0x1F
};
static const uint8_t init_block_12[] = {
    0xF1, 0x01, 0x17, 0xD1,
    0x00, 0x1F, 0x1F, 0x1F, 0x1F, 0x1F, 0x1F, 0x1F, 0x1F, 0x1F,
    0x1F, 0x02, 0x00, 0x04, 0x06, 0x08, 0x0A, 0x1E, 0x15, 0x1F, 0x1F, 0x15, 0x1F
};
static const uint8_t init_block_13[] = {
    0xF1, 0x01, 0x17, 0xD2,
    0x00, 0x1F, 0x1F, 0x1F, 0x1F, 0x1F, 0x1F, 0x1F, 0x1F, 0x1F,
    0x1F, 0x00, 0x02, 0x0A, 0x08, 0x06, 0x04, 0x1F, 0x15, 0x1F, 0x1F, 0x15, 0x1E
};
static const uint8_t init_block_14[] = {
    0xF1, 0x01, 0x17, 0xD3,
    0x00, 0x1F, 0x1F, 0x1F, 0x1F, 0x1F, 0x1F, 0x1F, 0x1F, 0x1F,
    0x1F, 0x01, 0x03, 0x0B, 0x09, 0x07, 0x05, 0x1F, 0x15, 0x1F, 0x1F, 0x15, 0x1E
};
static const uint8_t init_block_15[] = {                                                                  // GIP timing
    0xF1, 0x01, 0x25, 0xD4,
    0x30, 0x00, 0x00, 0x04, 0x00, 0x06, 0x00, 0x00, 0x00, 0x00,
    0x00, 0x03, 0x03, 0x00, 0x11, 0x00, 0x01, 0xC0, 0x04, 0x01,
    0x01, 0x11, 0x80, 0x01, 0xC0, 0x05, 0x01, 0x01, 0x00, 0x00,
    0x00, 0x04, 0x00, 0x06, 0x18, 0x02, 0xE3
};
static const uint8_t init_block_16[] = {
    0xF1, 0x01, 0x08, 0xD5, 0x68, 0x73, 0x00, 0x08, 0x08, 0x00, 0x03, 0x00
};
static const uint8_t init_block_17[] = {
    0xF1, 0x01, 0x06, 0xB7, 0x00, 0xD8, 0x00, 0x00, 0xD8, 0x00
};
static const uint8_t init_block_18[] = {                                                                  // Gamma positive
    0xF1, 0x01, 0x26, 0xC8,
    0x7F, 0x69, 0x58, 0x4C, 0x48, 0x39, 0x3E, 0x28, 0x42, 0x42,
    0x43, 0x62, 0x51, 0x58, 0x4A, 0x45, 0x37, 0x25, 0x0F,
    0x7F, 0x69, 0x58, 0x4C, 0x48, 0x39, 0x3E, 0x28, 0x42, 0x42,
    0x43, 0x62, 0x51, 0x58, 0x4A, 0x45, 0x37, 0x25, 0x0F
};
static const uint8_t init_block_19[] = {                                                                  // Gamma negative
    0xF1, 0x01, 0x26, 0xC8,
    0x7F, 0x66, 0x55, 0x47, 0x43, 0x33, 0x37, 0x21, 0x3B, 0x3A,
    0x3A, 0x57, 0x43, 0x49, 0x3A, 0x37, 0x2A, 0x1D, 0x0F,
    0x7F, 0x66, 0x55, 0x47, 0x43, 0x33, 0x37, 0x21, 0x3B, 0x3A,
    0x3A, 0x57, 0x43, 0x49, 0x3A, 0x37, 0x2A, 0x1D, 0x0F
};
static const uint8_t init_block_20[] = { 0xF1, 0x01, 0x01, 0xDE, 0x02 };                                  // Page DE=2
static const uint8_t init_block_21[] = { 0xF1, 0x01, 0x04, 0xBB, 0x00, 0x5B, 0x5C, 0x41 };
static const uint8_t init_block_22[] = { 0xF1, 0x01, 0x03, 0xB5, 0x00, 0x5A, 0x0A };
static const uint8_t init_block_23[] = { 0xF1, 0x01, 0x01, 0xC6, 0x22 };
static const uint8_t init_block_24[] = { 0xF1, 0x01, 0x01, 0xD7, 0x12 };
static const uint8_t init_block_25[] = { 0xF1, 0x01, 0x03, 0xCC, 0x15, 0x04, 0x35 };
static const uint8_t init_block_26[] = { 0xF1, 0x01, 0x01, 0xDE, 0x00 };                                  // Page DE=0
static const uint8_t init_block_27[] = { 0xF1, 0x01, 0x01, 0x35, 0x00 };                                  // TE on
static const uint8_t init_block_28[] = { 0xF1, 0x01, 0x01, 0x36, 0x0B };                                  // MADCTL: RGB order
static const uint8_t init_block_29[] = { 0xF1, 0x01, 0x01, 0x3A, 0x77 };                                  // COLMOD 24-bit
static const uint8_t init_block_30[] = { 0xF1, 0x01, 0x00, 0x11 };                                        // Sleep Out
static const uint8_t init_block_31[] = { 0xF1, 0x01, 0x00, 0x29 };                                        // Display On
// clang-format on

typedef struct {
    const uint8_t *data;
    size_t len;
    uint16_t delay_ms;  // 发送后延时
} init_cmd_t;

#define CMD(blk, dly) { .data = blk, .len = sizeof(blk), .delay_ms = (dly) }

static const init_cmd_t init_sequence[] = {
    CMD(init_block_00, 0),  CMD(init_block_01, 0),  CMD(init_block_02, 0),
    CMD(init_block_03, 0),  CMD(init_block_04, 0),  CMD(init_block_05, 0),
    CMD(init_block_06, 0),  CMD(init_block_07, 0),  CMD(init_block_08, 0),
    CMD(init_block_09, 0),  CMD(init_block_10, 0),  CMD(init_block_11, 0),
    CMD(init_block_12, 0),  CMD(init_block_13, 0),  CMD(init_block_14, 0),
    CMD(init_block_15, 0),  CMD(init_block_16, 0),  CMD(init_block_17, 0),
    CMD(init_block_18, 0),  CMD(init_block_19, 0),  CMD(init_block_20, 0),
    CMD(init_block_21, 0),  CMD(init_block_22, 0),  CMD(init_block_23, 0),
    CMD(init_block_24, 0),  CMD(init_block_25, 0),  CMD(init_block_26, 0),
    CMD(init_block_27, 0),  CMD(init_block_28, 0),  CMD(init_block_29, 0),
    CMD(init_block_30, 600),  // Sleep Out → 等 600ms
    CMD(init_block_31, 200),  // Display On → 等 200ms
};

#define INIT_SEQ_COUNT (sizeof(init_sequence) / sizeof(init_sequence[0]))

esp_err_t lcd_jd9168s_spi_init(void)
{
    ESP_LOGI(TAG, "JD9168S SPI init: CS=%d SCLK=%d MOSI=%d", PIN_LCD_CS, PIN_LCD_SCLK, PIN_LCD_MOSI);

    spi_bus_config_t bus_cfg = {
        .mosi_io_num = PIN_LCD_MOSI,
        .miso_io_num = -1,
        .sclk_io_num = PIN_LCD_SCLK,
        .quadwp_io_num = -1,
        .quadhd_io_num = -1,
        .max_transfer_sz = 64,
    };
    esp_err_t ret = spi_bus_initialize(SPI2_HOST, &bus_cfg, SPI_DMA_DISABLED);
    if (ret != ESP_OK) {
        ESP_LOGE(TAG, "SPI bus init failed: %s", esp_err_to_name(ret));
        return ret;
    }

    spi_device_interface_config_t dev_cfg = {
        .clock_speed_hz = 2 * 1000 * 1000,  // 2MHz 保守起步（走 GPIO 矩阵 + 0R 并联 stub）
        .mode = 0,                          // CPOL=0, CPHA=0
        .spics_io_num = PIN_LCD_CS,
        .queue_size = 1,
    };
    spi_device_handle_t spi;
    ret = spi_bus_add_device(SPI2_HOST, &dev_cfg, &spi);
    if (ret != ESP_OK) {
        ESP_LOGE(TAG, "SPI add device failed: %s", esp_err_to_name(ret));
        return ret;
    }

    for (int i = 0; i < INIT_SEQ_COUNT; i++) {
        spi_transaction_t t = {
            .length = init_sequence[i].len * 8,
            .tx_buffer = init_sequence[i].data,
        };
        ret = spi_device_transmit(spi, &t);
        if (ret != ESP_OK) {
            ESP_LOGE(TAG, "SPI tx block %d failed: %s", i, esp_err_to_name(ret));
            return ret;
        }
        // 每块打一行：块号 / 寄存器 / 长度 / 延时
        ESP_LOGI(TAG, "  block %02d: reg=0x%02X len=%d%s%s", i,
                 init_sequence[i].data[3 < init_sequence[i].len ? 3 : init_sequence[i].len - 1],
                 (int)init_sequence[i].len,
                 init_sequence[i].delay_ms ? " delay=" : "",
                 init_sequence[i].delay_ms ? (i == INIT_SEQ_COUNT - 2 ? "600ms" : "200ms") : "");
        if (init_sequence[i].delay_ms > 0) {
            vTaskDelay(pdMS_TO_TICKS(init_sequence[i].delay_ms));
        }
    }

    // 释放总线让 CS/SCLK/MOSI 回到空闲电平（面板初始化是一次性的）
    spi_bus_remove_device(spi);
    spi_bus_free(SPI2_HOST);

    ESP_LOGI(TAG, "JD9168S init 完成（%d 块）", (int)INIT_SEQ_COUNT);
    return ESP_OK;
}
